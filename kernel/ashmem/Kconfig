## kernel/drivers/gpu/vita/Kconfig
```kconfig
# Vita GPU Probe Configuration

config VITA_GPU_PROBE
	bool "Vita SGX543MP4+ Read-Only Probe (G2)"
	depends on ARCH_VITA
	help
	  This is a READ-ONLY probe for the Vita's PowerVR SGX543MP4+ GPU.
	  It enables the GPU clock, deasserts reset, maps the register block,
	  and reads ID/revision/status registers — printing them to dmesg.
	  
	  NO GPU WRITES are performed beyond clock/reset enable.
	  
	  This is the G2 gate in the reverse-engineering plan:
	  https://github.com/.../androidonvita/docs/reverse-engineering.md
	  
	  If this probe hangs the bus or reads an invalid ID, the GPU
	  reverse-engineering track stops here.
	  
	  Enable only for research builds. Not for production kernels.
# Vita GPU Driver Configuration

config VITA_GPU_DRIVER
	bool "Vita SGX543MP4+ GPU driver skeleton (G4 research)"
	depends on ARCH_VITA
	help
	  This is a RESEARCH SKELETON for the Vita's PowerVR SGX543MP4+ GPU.
	  It powers the GPU on, maps registers, reads ID/revision registers,
	  sets up command-ring infrastructure placeholders, and registers
	  an IRQ stub.

	  Does NOT submit jobs, does NOT load firmware, does NOT expose
	  GLES/EGL. The G3 (firmware) gate and userspace UMD/GLSL compiler
	  are blocked and not provided here.

	  Gate: G2 read-only probe must pass on hardware before enabling.

	  Enable only for research builds. Not for production kernels.
```

## kernel/lowmemorykiller/Kconfig
```kconfig
# SPDX-License-Identifier: GPL-2.0
# See kernel/logger/Kconfig: the ANDROID symbol is gone in 6.12, so the
# fragments opt in explicitly.
config ANDROID_LOW_MEMORY_KILLER
	tristate "Android lowmemorykiller"
	default n
	help
	  This is the Android lowmemorykiller driver. It monitors memory usage
	  and kills processes when memory is low, based on their oom_adj scores.
	  This driver was removed from mainline Linux in 6.12 but is still
	  required for Android 4.x and earlier (Android 5.0+ uses userspace lmkd).

	  If you are building Android 4.x or earlier, say Y.
```
