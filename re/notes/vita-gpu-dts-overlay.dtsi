/*
 * Vita GPU Device Tree Overlay (SceGpuEs4 findings)
 *
 * Values derived from gpu_es4.skprx; see re/notes/gpu-irq.md.
 * Apply to vita1000.dts / vita.dtsi to enable the psp2sgx probe.
 * The clock and reset consumers are still unknown.
 */

/ {
	/* GPU node for SGX543MP4+ */
	gpu: gpu@e8400000 {
		compatible = "sony,vita-gpu";
		reg = <0xe8400000 0x20000>;	/* SGX register block */
		interrupts = <GIC_SPI 20 IRQ_TYPE_LEVEL_HIGH>;	/* VitaOS 0x34 - 0x20 */
		clocks = <&XXXX CLK_ID_XXXX>;	/* clock still unknown */
		clock-names = "gpu";
		resets = <&syscon RESET_BIT_XXXX>;	/* reset still unknown */
		reset-names = "gpu";
		status = "okay";
	};
};

/*
 * Also need to add clock/reset to syscon if not present:
 *
 * &syscon {
 *     gpu_clk: clock@XXX { ... };
 *     gpu_rst: reset@XXX { ... };
 * };
 */
